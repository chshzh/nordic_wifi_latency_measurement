## CMakeLists.txt
```
#
# Copyright (c) 2025 Nordic Semiconductor ASA
#
# SPDX-License-Identifier: LicenseRef-Nordic-5-Clause
#

cmake_minimum_required(VERSION 3.20.0)

find_package(Zephyr REQUIRED HINTS $ENV{ZEPHYR_BASE})
project(wifi_udp_latency)

# Common source files
target_sources(app PRIVATE
    src/main.c
    src/wifi_utils.c
    src/udp_utils.c
    src/led_utils.c
    src/raw_utils.c
    src/net_event_mgmt_utils.c
) 
```

## Kconfig
```
#
# Copyright (c) 2025 Nordic Semiconductor ASA
#
# SPDX-License-Identifier: LicenseRef-Nordic-5-Clause
#

menu "WIFI Latency Test Configuration"

choice WIFI_LATENCY_TEST_PACKET_TYPE
	prompt "Transmission type"
	default WIFI_LATENCY_TEST_PACKET_TYPE_UDP
	help
	  Select the transmission type for latency testing

config WIFI_LATENCY_TEST_PACKET_TYPE_RAW
	bool "Raw IEEE 802.11 packet transmission"
	help
	  Use raw IEEE 802.11 packet transmission for latency testing

config WIFI_LATENCY_TEST_PACKET_TYPE_UDP
	bool "UDP packet transmission"
	help
	  Use standard UDP socket transmission for latency testing

endchoice

# Common configurations for both packet types
choice WIFI_LATENCY_TEST_DEVICE_ROLE_TYPE
	prompt "Device role"
	default WIFI_LATENCY_TEST_DEVICE_ROLE_TX
	help
	  Select the role of this device in the test

config WIFI_LATENCY_TEST_DEVICE_ROLE_TX
	bool "TX device"
	help
	  This device will transmit packets (UDP or Raw)

config WIFI_LATENCY_TEST_DEVICE_ROLE_RX
	bool "RX device"
	help
	  This device will receive packets (UDP or Raw)

endchoice

# Common configurations for all packet types
config WIFI_LATENCY_TEST_SOCKET_PORT
	int "Socket port for communication"
	default 12345
	depends on WIFI_LATENCY_TEST_PACKET_TYPE_UDP
	help
	  Port number used for UDP communication between devices

config WIFI_LATENCY_TEST_DURATION_MS
	int "Test duration in milliseconds"
	default 10000
	help
	  Duration of the test in milliseconds

config WIFI_LATENCY_TEST_INTERVAL_MS
	int "Packet transmission interval in milliseconds"
	default 1000
	help
	  Interval between packet transmissions in milliseconds

config WIFI_LATENCY_TEST_REG_DOMAIN
	string "The ISO/IEC alpha2 country code"
	default "00"
	depends on UDP_RX_DEV_MODE_SOFTAP || RAW_RX_DEV_MODE_MONITOR
	help
	  Set the ISO/IEC alpha2 country code for the country in
	  which the device is currently operating.
	  For world regulatory, use "00".

# UDP specific configurations
if WIFI_LATENCY_TEST_PACKET_TYPE_UDP

if WIFI_LATENCY_TEST_DEVICE_ROLE_TX
config UDP_TX_DEV_MODE_STA
	bool "TX device in Station mode"
	default y
	help
	  TX device operates in Station mode to connect to an AP
config UDP_TX_DEV_TARGET_IP
	string "Target IP address for UDP TX device"
	default "192.168.1.100"
	help
	  IP address of the UDP RX device
endif # WIFI_LATENCY_TEST_DEVICE_ROLE_TX

if WIFI_LATENCY_TEST_DEVICE_ROLE_RX
choice UDP_RX_DEV_MODE
	prompt "UDP RX device mode"
	default UDP_RX_DEV_MODE_STA
	help
	  Select the test mode for UDP RX device

config UDP_RX_DEV_MODE_STA
	bool "Both devices connect to external AP"
	help
	  Test 1: Both devices connect to an external access point

config UDP_RX_DEV_MODE_SOFTAP
	bool "RX device as SoftAP"
	help
	  Test 2: RX device acts as SoftAP, TX device connects to it

endchoice

if UDP_RX_DEV_MODE_SOFTAP
config SOFTAP_SSID
	string "SoftAP SSID"
	default "wifi-latency-meas"
	help
	  SSID for the SoftAP when RX device acts as access point

config SOFTAP_PASSWORD
	string "SoftAP password"
	default "nordicnrf7x"
	help
	  Password for the SoftAP when RX device acts as access point

endif # UDP_RX_DEV_MODE_SOFTAP

endif # WIFI_LATENCY_TEST_DEVICE_ROLE_RX

endif # WIFI_LATENCY_TEST_PACKET_TYPE_UDP

# Raw packet specific configurations
if WIFI_LATENCY_TEST_PACKET_TYPE_RAW

if WIFI_LATENCY_TEST_DEVICE_ROLE_TX

choice RAW_TX_DEV_MODE
	prompt "Raw TX transmission mode"
	default RAW_TX_DEV_MODE_NON_CONNECTED
	help
	  Select raw transmission mode

config RAW_TX_DEV_MODE_NON_CONNECTED
	bool "Non-connected mode"
	help
	  Transmit raw packets without connecting to an AP

config RAW_TX_DEV_MODE_CONNECTED
	bool "Connected mode"
	help
	  Connect to an AP before transmitting raw packets

endchoice

config RAW_TX_DEV_INJECTION_ENABLE
	bool "Enable TX injection mode"
	default y
	help
	  Enable TX injection mode for raw packet transmission

config RAW_TX_DEV_CHANNEL
	int "Channel for non-connected Station mode"
	depends on RAW_TX_DEV_MODE_NON_CONNECTED
	range 1 233
	help
	  Specify the Wi-Fi channel for transmitting raw TX packets in non-connected Station mode.
	  The valid channel range is 1 to 233.

config RAW_TX_DEV_RATE_VALUE
	int "MCS index or Data rate value"
	default 0
	help
	  Specify the Wi-Fi data rate value for raw TX packet transmission.
	  The value represents either the data rate in Mbps or Modulation and coding (MCS) index.
	  Note: 5.5Mbps is treated specially as 55 to avoid floating point usage.
	  Legacy: 1, 2, 55, 11, 6, 9, 12, 18, 24, 36, 48, 54
	  MCS index: 0-7

config RAW_TX_DEV_RATE_FLAGS
	int "Rate flag value"
	range 0 4
	default 1
	help
	  Specify the rate flag value to be used for raw TX packet transmission.
	  Rate Flags:
	  0 - Legacy
	  1 - 11n format
	  2 - VHT format
	  3 - HE_SU
	  4 - HE_ER_SU

config RAW_TX_DEV_QUEUE_NUM
	int "Queue number"
	default 0
	range 0 4
	help
	  Specify the transmission queue number for raw TX packets.
	  0 - Background
	  1 - Best effort
	  2 - Video
	  3 - Voice
	  4 - Beacon.

endif # WIFI_LATENCY_TEST_DEVICE_ROLE_TX


if WIFI_LATENCY_TEST_DEVICE_ROLE_RX
choice RAW_RX_DEV_MODE
	prompt "Raw RX device mode"
	default RAW_RX_DEV_MODE_MONITOR
	help
	  Select the test mode for Raw RX device

config RAW_RX_DEV_MODE_MONITOR
	bool "RX device in Monitor mode"
	help
	  RX device operates in monitor mode to capture raw packets

config RAW_RX_DEV_MODE_PROMISCUOUS
	bool "RX device in Promiscuous mode"
	help
	  RX device operates in promiscuous mode to capture raw packets

endchoice

if RAW_RX_DEV_MODE_MONITOR
config RAW_RX_DEV_MODE_MONITOR_CHANNEL
	int "Wi-Fi channel for monitor mode"
	default 1
	range 1 233
	help
	  Wi-Fi channel to monitor for raw packets

config RAW_RX_DEV_RX_STACK_SIZE
	int "RX thread stack size for monitor mode"
	default 4096
	help
	  Stack size for the RX thread in monitor mode
endif # RAW_RX_DEV_MODE_MONITOR

if RAW_RX_DEV_MODE_PROMISCUOUS
config RAW_RX_DEV_MODE_PROMISCUOUS_RECV_BUFFER_SIZE
	int "Receive buffer size for promiscuous mode"
	default 1024
	help
	  Size of the receive buffer for promiscuous mode

config RAW_RX_DEV_MODE_PROMISCUOUS_RX_THREAD_STACK_SIZE
	int "RX thread stack size for promiscuous mode"
	default 4096
	help
	  Stack size for the RX thread in promiscuous mode
endif # RAW_RX_DEV_MODE_PROMISCUOUS

endif # WIFI_LATENCY_TEST_DEVICE_ROLE_RX

endif # WIFI_LATENCY_TEST_PACKET_TYPE_RAW

endmenu

source "Kconfig.zephyr" 
```

## sample.yaml
```
sample:
  description: Wi-Fi UDP Latency Test application for nRF7002 DK
  name: Wi-Fi UDP Latency Test
tests:
  # Test 1: TX Device for external AP scenario
  sample.wifi_udp_latency.test1_tx:
    sysbuild: true
    build_only: true
    integration_platforms:
      - nrf7002dk/nrf5340/cpuapp
    platform_allow:
      - nrf7002dk/nrf5340/cpuapp
    tags:
      - ci_build
      - sysbuild
      - ci_samples_wifi
      - latency_test
    extra_args: EXTRA_CONF_FILE=overlay-test1-tx.conf

  # Test 1: RX Device for external AP scenario  
  sample.wifi_udp_latency.test1_rx:
    sysbuild: true
    build_only: true
    integration_platforms:
      - nrf7002dk/nrf5340/cpuapp
    platform_allow:
      - nrf7002dk/nrf5340/cpuapp
    tags:
      - ci_build
      - sysbuild
      - ci_samples_wifi
      - latency_test
    extra_args: EXTRA_CONF_FILE=overlay-test1-rx.conf

  # Test 2: TX Device for SoftAP scenario
  sample.wifi_udp_latency.test2_tx:
    sysbuild: true
    build_only: true
    integration_platforms:
      - nrf7002dk/nrf5340/cpuapp
    platform_allow:
      - nrf7002dk/nrf5340/cpuapp
    tags:
      - ci_build
      - sysbuild
      - ci_samples_wifi
      - latency_test
      - softap
    extra_args: EXTRA_CONF_FILE=overlay-test2-tx.conf

  # Test 2: RX Device for SoftAP scenario
  sample.wifi_udp_latency.test2_rx:
    sysbuild: true
    build_only: true
    integration_platforms:
      - nrf7002dk/nrf5340/cpuapp
    platform_allow:
      - nrf7002dk/nrf5340/cpuapp
    tags:
      - ci_build
      - sysbuild
      - ci_samples_wifi
      - latency_test
      - softap
    extra_args: EXTRA_CONF_FILE=overlay-test2-rx.conf 
```

## west.yml
```
# Copyright (c) 2025 Nordic Semiconductor ASA
# SPDX-License-Identifier: LicenseRef-Nordic-5-Clause

manifest:
  self:
    path: wifi_latency_test

  remotes:
    - name: ncs
      url-base: https://github.com/nrfconnect

  projects:
    - name: nrf
      remote: ncs
      repo-path: sdk-nrf
      revision: v3.1.0
      import: true
```

## prj.conf
```kconfig
#
# Copyright (c) 2025 Nordic Semiconductor ASA
#
# SPDX-License-Identifier: LicenseRef-Nordic-5-Clause
#

# -General Kernel Options START
CONFIG_MAIN_STACK_SIZE=6144
CONFIG_THREAD_NAME=y #selected by CONFIG_THREAD_ANALYZER
CONFIG_SYSTEM_WORKQUEUE_STACK_SIZE=4096
# -General Kernel Options END


# -General Architecture Options START
# --Interrupt Configuration START
CONFIG_ISR_TABLES_LOCAL_DECLARATION=y #depended by CONFIG_LTO
# --Interrupt Configuration END
# -General Architecture Options END


# -Device Drivers START
# --Flash drivers START
CONFIG_FLASH=y
# CONFIG_FLASH_PAGE_LAYOUT=y #selected by CONFIG_NVS
# ---Flash map abstraction module START
CONFIG_FLASH_MAP=y
# ---Flash map abstraction module END
# --Flash drivers END
# --Wi-Fi drivers START
CONFIG_WIFI=y
CONFIG_WIFI_CREDENTIALS=y
CONFIG_WIFI_NM_WPA_SUPPLICANT=y #select POSIX_API POSIX_TIMERS NET_SOCKETS
# ---nRF70 driver START
# CONFIG_WIFI_NRF70  #default y if DT_HAS_NORDIC_NRF7002_SPI_ENABLED || DT_HAS_NORDIC_NRF7002_QSPI_ENABLED
# CONFIG_NET_L2_ETHERNET #default y if (!NRF70_RADIO_TEST && !NRF70_OFFLOADED_RAW_TX)
# CONFIG_NRF_WIFI_CTRL_HEAP_SIZE=20000 #default 20000
CONFIG_NRF_WIFI_DATA_HEAP_SIZE=54856
CONFIG_NRF_WIFI_LOW_POWER=n # Critical for socket packet low latency transmission
CONFIG_NRF70_RX_NUM_BUFS=16
CONFIG_NRF70_MAX_TX_AGGREGATION=4
# CONFIG_NRF70_MAX_TX_TOKENS=10 #default 10
# CONFIG_NRF70_TX_MAX_DATA_SIZE=1600 #default 1600
# CONFIG_NRF70_RX_MAX_DATA_SIZE=1600 #default 1600
# CONFIG_MAIN_STACK_SIZE=6144
# CONFIG_SYSTEM_WORKQUEUE_STACK_SIZE=4096
# ----nRF70 driver END
# --Wi-Fi drivers END
# -Device Drivers START


# Modules START
# --Nordic nRF Connect START
#CONFIG_MAIN_STACK_SIZE= #Multiple definitions
# ---Subsystems START
# ----Networking START
# ----- Application Protocol START
# ------Wi-Fi Ready Library START
# CONFIG_WIFI_READY_LIB=y # replaced by WPA supplicant event check
# ------Wi-Fi Ready Library END
# ----- Application Protocol END
# -----L2 Wi-Fi Connectivity START
CONFIG_L2_WIFI_CONNECTIVITY=y #depends on NET_CONNECTION_MANAGER select NET_CONNECTION_MANAGER_CONNECTIVITY_WIFI_MGMT
CONFIG_L2_WIFI_CONNECTIVITY_AUTO_CONNECT=n
CONFIG_L2_WIFI_CONNECTIVITY_AUTO_DOWN=n
# -----L2 Wi-Fi Connectivity END
# ----Networking END
# ---Subsystems END
# ---Libraries START
# ----Button and LED Library for Nordic DKs START
CONFIG_DK_LIBRARY=y
# ----Button and LED Library for Nordic DKs END
# ----Hardware ID START
CONFIG_HW_ID_LIBRARY=y
CONFIG_HW_ID_LIBRARY_SOURCE_NET_MAC=y
# ----Hardware ID END
# ---Libraries END
# --Nordic nRF Connect END
# Modules END


# -Additional libraries START
# --Heap and Memory Allocation START
# CONFIG_SYS_HEAP_LISTENER=y # See usage:https://github.com/chshzh/nordic_wifi_opus_audio_demo/blob/main/wifi_audio/wifi_audio_gateway/main.c
# CONFIG_SYS_HEAP_RUNTIME_STATS=y
# --Heap and Memory Allocation END
# --POSIX API Support START
# CONFIG_POSIX_API=y #selected by CONFIG_WIFI_NM_WPA_SUPPLICANT
# CONFIG_POSIX_TIMERS=y #selected by CONFIG_WIFI_NM_WPA_SUPPLICANT
# --POSIX API Support END
# -Additional libraries END

# -Subsystems and OS Services START
# --System Monitoring Options START
# CONFIG_THREAD_ANALYZER=y #Enable Segger Ozone Support
# CONFIG_THREAD_ANALYZER_AUTO=y # printk/log periotic thread information
# CONFIG_THREAD_ANALYZER_AUTO_INTERVAL=10
# --System Monitoring Options END
# --Debugging Options START
CONFIG_STACK_SENTINEL=y
# --Debugging Options END
# --File Systems START
CONFIG_FILE_SYSTEM=y
CONFIG_FILE_SYSTEM_LITTLEFS=y
CONFIG_NVS=y
# ---Zephyr Memory Storag(ZMS) START
CONFIG_ZMS=y
# ---Zephyr Memory Storage(ZMS) END
# --File Systems END
# --Logging START
CONFIG_LOG=y
CONFIG_LOG_MODE_DEFERRED=y
# --Logging END
# --Networking START
CONFIG_NETWORKING=y
# ---L2 Link layer START
# ---L2 Link layer END
# ---IP Stack START
CONFIG_NET_IPV4=y
CONFIG_NET_UDP=y
CONFIG_NET_PKT_RX_COUNT=8
CONFIG_NET_PKT_TX_COUNT=8
CONFIG_NET_BUF_RX_COUNT=8
CONFIG_NET_BUF_TX_COUNT=16
# ----Network Management START
# CONFIG_NET_MGMT=y # selected by CONFIG_NET_CONNECTION_MANAGER net_mgmt_*
# CONFIG_NET_MGMT_EVENT=y # selected by CONFIG_NET_CONNECTION_MANAGER
# CONFIG_NET_MGMT_EVENT_INFO=y # selected by CONFIG_NET_CONNECTION_MANAGER
# ----Network Management END
# ---IP Stack END
# ---Network Protocols START
# ---Network Protocols END
# ---Network Libraries START
# ----Set network settings for applications START
CONFIG_NET_CONFIG_SETTINGS=y
CONFIG_NET_CONFIG_INIT_TIMEOUT=0
# ----Set network settings for applications END
# ----BSD Sockets compatible API START
# CONFIG_NET_SOCKETS=y
# ----BSD Sockets compatible API END
# ---Network Libraries END
# ---Network additional services START
# ----Network DHCPv4 START
CONFIG_NET_DHCPV4=y # DHCPv4 client
# ----Network DHCPv4 END
# --Network additional services END
# ---Network connection manager START
CONFIG_NET_CONNECTION_MANAGER=y # conn_mgr_*
# ---Network connection manager END
# --Networking END
# --Settings START
CONFIG_SETTINGS=y
# CONFIG_SETTINGS_ZMS=y #default SETTINGS_ZMS if ZMS
# --Settings END
# --Tracing Support START
# CONFIG_TRACING=y #Enable Segger Systemview
# CONFIG_SEGGER_SYSTEMVIEW=y #Enable Segger Systemview
# CONFIG_TRACING_BACKEND_RAM=y #Enable Segger Systemview
# --Tracing Support END
# -Subsystems and OS Services END


# -Build and Link Features START
CONFIG_LTO=y #depends on !(GEN_ISR_TABLES || GEN_IRQ_VECTOR_TABLE) || ISR_TABLES_LOCAL_DECLARATION
# -Build and Link Features END
```

## overlay-raw-rx-monitor.conf
```kconfig
#
# Copyright (c) 2025 Nordic Semiconductor ASA
#
# SPDX-License-Identifier: LicenseRef-Nordic-5-Clause
#

# -Raw Packet Latency Test Configuration: RX Device in Monitor Mode START
CONFIG_WIFI_LATENCY_TEST_PACKET_TYPE_RAW=y
CONFIG_WIFI_LATENCY_TEST_DEVICE_ROLE_RX=y
CONFIG_RAW_RX_DEV_MODE_MONITOR=y
CONFIG_RAW_RX_DEV_MODE_MONITOR_CHANNEL=2
# -Raw Packet Latency Test Configuration: RX Device in Monitor Mode END

# -Device Drivers START
# --Wi-Fi drivers START
# ---nRF70 driver START
CONFIG_NRF_WIFI_DATA_HEAP_SIZE=168192
CONFIG_NRF70_RAW_DATA_RX=y
# ---nRF70 driver END
# --Wi-Fi drivers END
# -Device Drivers START

# -Subsystems and OS Services START
# --Networking START
# ---IP Stack START
CONFIG_NET_PKT_RX_COUNT=64
CONFIG_NET_PKT_TX_COUNT=3
CONFIG_NET_BUF_RX_COUNT=64
CONFIG_NET_BUF_TX_COUNT=6
CONFIG_NET_CONTEXT_RCVTIMEO=y
# ---IP Stack END
# ---Networking END
# --Subsystems and OS Services END
```

## overlay-raw-tx-sta-non-conn.conf
```kconfig
#
# Copyright (c) 2025 Nordic Semiconductor ASA
#
# SPDX-License-Identifier: LicenseRef-Nordic-5-Clause
#

# -Raw Packet Latency Test Configuration: TX Device in Non-Connected Mode START
CONFIG_WIFI_LATENCY_TEST_PACKET_TYPE_RAW=y
CONFIG_WIFI_LATENCY_TEST_DEVICE_ROLE_TX=y
CONFIG_WIFI_LATENCY_TEST_DURATION_MS=10000
CONFIG_WIFI_LATENCY_TEST_INTERVAL_MS=1000
# --Raw TX transmission mode START
CONFIG_RAW_TX_DEV_MODE_NON_CONNECTED=y
CONFIG_RAW_TX_DEV_CHANNEL=2
CONFIG_RAW_TX_DEV_INJECTION_ENABLE=y
# CONFIG_RAW_TX_DEV_RATE_VALUE=0
# CONFIG_RAW_TX_DEV_RATE_FLAGS=1
# CONFIG_RAW_TX_DEV_QUEUE_NUM=0
# --Raw TX transmission mode END
# -Raw Packet Latency Test Configuration: TX Device in Non-Connected Mode END

# -Device Drivers START
# --Wi-Fi drivers START
# ---nRF70 driver START
CONFIG_NRF70_RAW_DATA_TX=y
# ---nRF70 driver END
# --Wi-Fi drivers END
# -Device Drivers START
```

## overlay-rx-softap.conf
```kconfig
#
# Copyright (c) 2025 Nordic Semiconductor ASA
#
# SPDX-License-Identifier: LicenseRef-Nordic-5-Clause
#

# -UDP Packet Latency Test Configuration: RX+SoftAP Device START
CONFIG_WIFI_UDP_PACKET_LATENCY_DEVICE_ROLE_RX=y
CONFIG_WIFI_UDP_PACKET_LATENCY_TEST_MODE_SOFTAP=y
CONFIG_WIFI_UDP_PACKET_LATENCY_SOFTAP_SSID="wifi-latency-test"
CONFIG_WIFI_UDP_PACKET_LATENCY_SOFTAP_PSK="testpass123"
# -UDP Packet Latency Test Configuration: RX+SoftAP Device END


# -Device Drivers START
# --Wi-Fi drivers START
# CONFIG_WIFI_CREDENTIALS_STATIC=y
CONFIG_WIFI_NM_WPA_SUPPLICANT_AP=y
# fix stack overflow issue
CONFIG_WIFI_NM_WPA_SUPPLICANT_THREAD_STACK_SIZE=8192
# ---nRF70 driver START
CONFIG_NRF70_AP_MODE=y
# ----nRF70 driver END
# --Wi-Fi drivers END
# -Device Drivers START


# Modules START
# --Nordic nRF Connect START
#CONFIG_MAIN_STACK_SIZE= #Multiple definitions but here is normally last before application definition
# ---Subsystems START
# ----Networking START
# ----- Application Protocol START
# ------Wi-Fi Ready Library START
CONFIG_WIFI_READY_LIB=y
# ------Wi-Fi Ready Library END
# ----- Application Protocol END
# ----Networking END
# ---Subsystems END
# ---Libraries START
# ---Libraries END
# --Nordic nRF Connect END
# Modules END


# -Subsystems and OS Services START
# --Networking START
# ---Network Libraries START
# ----Set network settings for applications START
CONFIG_NET_CONFIG_MY_IPV4_ADDR="192.168.1.1"
CONFIG_NET_CONFIG_MY_IPV4_NETMASK="255.255.255.0"
CONFIG_NET_CONFIG_MY_IPV4_GW="192.168.1.1"
# ----Set network settings for applications END
# ---Network Libraries END
# ---Network additional services START
# ----Network DHCPv4 START
CONFIG_NET_DHCPV4_SERVER=y
# ----Network DHCPv4 END
# --Network additional services END
# --Networking END
# -Subsystems and OS Services END
```

## overlay-rx.conf
```kconfig
#
# Copyright (c) 2025 Nordic Semiconductor ASA
#
# SPDX-License-Identifier: LicenseRef-Nordic-5-Clause
#


# - -UDP Packet Latency Test Configuration: RX Device START
CONFIG_WIFI_UDP_PACKET_LATENCY_DEVICE_ROLE_RX=y
CONFIG_WIFI_UDP_PACKET_LATENCY_TEST_MODE_AP=y
# --UDP Packet Latency Test Configuration: RX Device END

# -Device Drivers START
# --Wi-Fi drivers START
# Wi-Fi credentials for external AP
CONFIG_WIFI_CREDENTIALS_STATIC=y
CONFIG_WIFI_CREDENTIALS_STATIC_SSID="YourWiFiSSID"
CONFIG_WIFI_CREDENTIALS_STATIC_PASSWORD="YourPASSWORD"
# --Wi-Fi drivers END
# -Device Drivers START
```

## overlay-tx.conf
```kconfig
#
# Copyright (c) 2025 Nordic Semiconductor ASA
#
# SPDX-License-Identifier: LicenseRef-Nordic-5-Clause
#


# --UDP Packet Latency Test Configuration: TX Device START
CONFIG_WIFI_UDP_PACKET_LATENCY_DEVICE_ROLE_TX=y
CONFIG_WIFI_UDP_PACKET_LATENCY_TEST_DURATION_MS=10000
CONFIG_WIFI_UDP_PACKET_LATENCY_PACKET_INTERVAL_MS=1000
CONFIG_WIFI_UDP_PACKET_LATENCY_TARGET_IP="192.168.1.1"
# --UDP Packet Latency Test Configuration: TX Device END


# -Device Drivers START
# --Wi-Fi drivers START
CONFIG_WIFI_CREDENTIALS_STATIC=y
#For Test 1: IP of RX device on same network
# CONFIG_WIFI_CREDENTIALS_STATIC_SSID="YourWiFiSSID"
# CONFIG_WIFI_CREDENTIALS_STATIC_PASSWORD="YourPASSWORD"
# CONFIG_WIFI_UDP_PACKET_LATENCY_TARGET_IP="192.168.1.100"
#For Test 2: IP of SoftAP (192.168.1.1)
CONFIG_WIFI_CREDENTIALS_STATIC_SSID="wifi-latency-test"
CONFIG_WIFI_CREDENTIALS_STATIC_PASSWORD="testpass123"
# --Wi-Fi drivers END
# -Device Drivers START
```

## overlay-udp-rx-softap.conf
```kconfig
#
# Copyright (c) 2025 Nordic Semiconductor ASA
#
# SPDX-License-Identifier: LicenseRef-Nordic-5-Clause
#

# -UDP Packet Latency Test Configuration: RX Device on SoftAP Mode START
CONFIG_WIFI_LATENCY_TEST_DEVICE_ROLE_RX=y
CONFIG_UDP_RX_DEV_MODE_SOFTAP=y
CONFIG_SOFTAP_SSID="wifi-latency-meas"
CONFIG_SOFTAP_PASSWORD="nordicnrf7x"
# -UDP Packet Latency Test Configuration: RX Device on SoftAP Mode END


# -Device Drivers START
# --Wi-Fi drivers START
# CONFIG_WIFI_CREDENTIALS_STATIC=y
CONFIG_WIFI_NM_WPA_SUPPLICANT_AP=y
# fix stack overflow issue
CONFIG_WIFI_NM_WPA_SUPPLICANT_THREAD_STACK_SIZE=8192
# ---nRF70 driver START
CONFIG_NRF70_AP_MODE=y
# ----nRF70 driver END
# --Wi-Fi drivers END
# -Device Drivers START


# Modules START
# --Nordic nRF Connect START
#CONFIG_MAIN_STACK_SIZE= #Multiple definitions but here is normally last before application definition
# ---Subsystems START
# ----Networking START
# ----- Application Protocol START
# ------Wi-Fi Ready Library START
# CONFIG_WIFI_READY_LIB=n # replaced by WPA supplicant event check
# ------Wi-Fi Ready Library END
# ----- Application Protocol END
# ----Networking END
# ---Subsystems END
# ---Libraries START
# ---Libraries END
# --Nordic nRF Connect END
# Modules END


# -Subsystems and OS Services START
# --Networking START
# ---Network Libraries START
# ----Set network settings for applications START
CONFIG_NET_CONFIG_MY_IPV4_ADDR="192.168.1.1"
CONFIG_NET_CONFIG_MY_IPV4_NETMASK="255.255.255.0"
CONFIG_NET_CONFIG_MY_IPV4_GW="192.168.1.1"
# ----Set network settings for applications END
# ---Network Libraries END
# ---Network additional services START
# ----Network DHCPv4 START
CONFIG_NET_DHCPV4_SERVER=y
# ----Network DHCPv4 END
# --Network additional services END
# --Networking END
# -Subsystems and OS Services END
```

## src/main.c
```c
/*
 * Copyright (c) 2025 Nordic Semiconductor ASA
 *
 * SPDX-License-Identifier: LicenseRef-Nordic-5-Clause
 */

#include <dk_buttons_and_leds.h>
#include <supp_events.h>
#include <zephyr/drivers/gpio.h>
#include <zephyr/kernel.h>
#include <zephyr/logging/log.h>
#include <zephyr/net/conn_mgr_connectivity.h>
#include <zephyr/net/conn_mgr_monitor.h>
#include <zephyr/net/dhcpv4_server.h>
#include <zephyr/net/net_event.h>
#include <zephyr/net/net_mgmt.h>
#include <zephyr/net/wifi_mgmt.h>

#include "led_utils.h"
#include "net_event_mgmt_utils.h"
#include "raw_utils.h"
#include "udp_utils.h"
#include "wifi_utils.h"

LOG_MODULE_REGISTER(main, CONFIG_LOG_DEFAULT_LEVEL);

/* External semaphores from net_event_mgmt_utils.c */
extern struct k_sem iface_up_sem;
extern struct k_sem wpa_supplicant_ready_sem;
extern struct k_sem ipv4_dhcp_bond_sem;

/* External semaphore from net_event_mgmt_utils.c for SoftAP mode */
#if IS_ENABLED(CONFIG_UDP_RX_DEV_MODE_SOFTAP)
extern struct k_sem station_connected_sem;
extern bool dhcp_server_started;
#endif
/* Function declarations */

#if IS_ENABLED(CONFIG_WIFI_LATENCY_TEST_DEVICE_ROLE_TX)
/* Button control for TX task */
K_SEM_DEFINE(tx_start_sem, 0, 1);
volatile bool tx_task_running = false;
volatile bool tx_task_should_stop = false;

/* Button callback function for TX device */
static void button_handler(uint32_t button_state, uint32_t has_changed)
{
	if (has_changed & DK_BTN1_MSK && button_state & DK_BTN1_MSK) {
		LOG_INF("Button 1 pressed - restarting TX task");

		/* Stop current TX task if running */
		if (tx_task_running) {
			tx_task_should_stop = true;
			LOG_INF("Stopping current TX task...");

			/* Wait a bit for task to stop */
			k_sleep(K_MSEC(100));
		}

		/* Signal to start new TX task */
		k_sem_give(&tx_start_sem);
	}
}
#endif /* CONFIG_WIFI_LATENCY_TEST_DEVICE_ROLE_TX */

#if IS_ENABLED(CONFIG_WIFI_LATENCY_TEST_DEVICE_ROLE_TX) &&                                         \
	IS_ENABLED(CONFIG_WIFI_LATENCY_TEST_PACKET_TYPE_RAW)
static void raw_tx_session(void)
{
	int ret;
	uint32_t packet_count = 0;
	int64_t start_time;
	uint32_t test_duration = CONFIG_WIFI_LATENCY_TEST_DURATION_MS;
	uint32_t packet_interval = CONFIG_WIFI_LATENCY_TEST_INTERVAL_MS;
	LOG_INF("Starting Raw TX session");
	/* Mark task as running */
	tx_task_running = true;
	tx_task_should_stop = false;

	ret = raw_tx_socket_init();

	if (ret < 0) {
		LOG_ERR("Failed to initialize raw TX socket");
		tx_task_running = false;
		return;
	}

	start_time = k_uptime_get();
	/* Main transmission loop */
	while ((k_uptime_get() - start_time) < test_duration && !tx_task_should_stop) {

		/* Prepare and trigger LED before transmission */
		led_trigger_tx();
		/* Send raw packet */
		ret = raw_tx_send_packet(packet_count);
		if (ret < 0) {
			LOG_ERR("Failed to send raw packet: %d", ret);
			break; /* Exit loop on error */
		} else {
			LOG_INF("Sent: Raw packet %u at %lld ms", packet_count, k_uptime_get());
		}

		packet_count++;
		/* Wait for next transmission with shorter intervals to check for stop
		 * signal */
		for (int i = 0; i < packet_interval / 10 && !tx_task_should_stop; i++) {
			k_sleep(K_MSEC(10));
		}
	}

	if (tx_task_should_stop) {
		LOG_INF("TX session stopped by button. Sent %u packets", packet_count);
	} else {
		LOG_INF("TX session completed. Sent %u packets", packet_count);
	}
	/* Cleanup raw socket */
	raw_tx_cleanup();
	tx_task_running = false;
	LOG_INF("Raw TX session completed");
	/* Reset task state */
	tx_task_should_stop = false;
	tx_task_running = false;
	LOG_INF("Raw TX task finished, Press Button 1 to restart packet transmission");
}

static void raw_tx_task(void)
{
	LOG_INF("TX device ready. Press Button 1 to start/restart packet transmission");

	/* Start first transmission session */
	raw_tx_session();

	/* Wait for button presses to restart transmission */
	while (1) {
		/* Wait for button press to restart */
		k_sem_take(&tx_start_sem, K_FOREVER);

		LOG_INF("Button 1 pressed - starting new TX session");
		raw_tx_session();
	}
}
#endif /* CONFIG_WIFI_LATENCY_TEST_DEVICE_ROLE_TX &&                                               \
	  CONFIG_WIFI_LATENCY_TEST_PACKET_TYPE_RAW */

#if IS_ENABLED(CONFIG_WIFI_LATENCY_TEST_DEVICE_ROLE_TX) &&                                         \
	IS_ENABLED(CONFIG_WIFI_LATENCY_TEST_PACKET_TYPE_UDP)

static void udp_tx_session(void)
{
	int ret;
	int udp_socket;
	struct sockaddr_in server_addr;
	uint32_t packet_count = 0;
	int64_t start_time;
	uint32_t test_duration = CONFIG_WIFI_LATENCY_TEST_DURATION_MS;
	uint32_t packet_interval = CONFIG_WIFI_LATENCY_TEST_INTERVAL_MS;

	LOG_INF("Starting UDP TX session");

	/* Mark task as running */
	tx_task_running = true;
	tx_task_should_stop = false;

	/* Create UDP socket */
	ret = udp_client_init(&udp_socket, &server_addr, CONFIG_UDP_TX_DEV_TARGET_IP,
			      CONFIG_WIFI_LATENCY_TEST_SOCKET_PORT);
	if (ret) {
		LOG_ERR("Failed to initialize UDP client: %d", ret);
		tx_task_running = false;
		return;
	}

	start_time = k_uptime_get();

	/* Main transmission loop */
	while ((k_uptime_get() - start_time) < test_duration && !tx_task_should_stop) {
		char payload[64];
		int64_t current_time = k_uptime_get();

		/* Prepare payload with timestamp and packet count */
		snprintf(payload, sizeof(payload), "Packet_%u_Time_%lld", packet_count,
			 current_time);

		/* Trigger LED before transmission */
		led_trigger_tx();

		/* Send UDP packet */
		ret = udp_send(udp_socket, &server_addr, payload, strlen(payload));
		if (ret < 0) {
			LOG_ERR("Failed to send UDP packet: %d", ret);
		} else {
			LOG_INF("Sent: UDP packet %u at %lld ms", packet_count, current_time);
			packet_count++;
		}

		/* Wait for next transmission with shorter intervals to check for stop
		 * signal */
		for (int i = 0; i < packet_interval / 10 && !tx_task_should_stop; i++) {
			k_sleep(K_MSEC(10));
		}
	}

	if (tx_task_should_stop) {
		LOG_INF("TX session stopped by button. Sent %u packets", packet_count);
	} else {
		LOG_INF("TX session completed. Sent %u packets", packet_count);
	}

	udp_client_cleanup(udp_socket);
	tx_task_running = false;
	LOG_INF("UDP TX task finished, Press Button 1 to start/restart packet "
		"transmission");
}

static void udp_tx_task(void)
{
	LOG_INF("TX device ready. Press Button 1 to start/restart packet transmission");

	/* Start first transmission session */
	udp_tx_session();

	/* Wait for button presses to restart transmission */
	while (1) {
		/* Wait for button press to restart */
		k_sem_take(&tx_start_sem, K_FOREVER);

		LOG_INF("Button 1 pressed - starting new TX session");
		udp_tx_session();
	}
}
#endif /* CONFIG_WIFI_LATENCY_TEST_DEVICE_ROLE_TX &&                                               \
	  CONFIG_WIFI_LATENCY_TEST_PACKET_TYPE_UDP */

#if IS_ENABLED(CONFIG_WIFI_LATENCY_TEST_PACKET_TYPE_UDP) &&                                        \
	IS_ENABLED(CONFIG_WIFI_LATENCY_TEST_DEVICE_ROLE_RX)
static void udp_rx_task(void)
{
	int ret;
	int udp_socket;
	uint32_t packet_count = 0;

	/* Create UDP socket for receiving */
	ret = udp_server_init(&udp_socket, CONFIG_WIFI_LATENCY_TEST_SOCKET_PORT);
	if (ret) {
		LOG_ERR("Failed to initialize UDP server: %d", ret);
		return;
	}

	LOG_INF("UDP server listening on port %d", CONFIG_WIFI_LATENCY_TEST_SOCKET_PORT);

	/* Main reception loop */
	while (1) {
		char buffer[256];
		int64_t current_time = k_uptime_get();

		ret = udp_receive(udp_socket, buffer, sizeof(buffer));
		if (ret > 0) {
			/* Trigger LED when packet received */
			led_trigger_rx();

			buffer[ret] = '\0'; /* Null-terminate */
			LOG_INF("Received: %s at %lld ms", buffer, current_time);
			packet_count++;
		} else if (ret < 0) {
			LOG_ERR("Failed to receive UDP packet: %d", ret);
			k_sleep(K_MSEC(100));
		}
	}

	LOG_INF("RX task completed. Received %u packets", packet_count);
	udp_server_cleanup(udp_socket);
}
#endif /* CONFIG_WIFI_LATENCY_TEST_DEVICE_ROLE_RX */

int main(void)
{
	int ret;

	LOG_INF("Starting Wi-Fi Packet Latency Test Application");
#if IS_ENABLED(CONFIG_WIFI_LATENCY_TEST_PACKET_TYPE_UDP)
	LOG_INF("Transmission mode: UDP packets");
#elif IS_ENABLED(CONFIG_WIFI_LATENCY_TEST_PACKET_TYPE_RAW)
	LOG_INF("Transmission mode: Raw IEEE 802.11 packets");
#endif

	/* Initialize LED GPIO for timing measurements */
	ret = led_init();
	if (ret) {
		LOG_ERR("Failed to initialize LEDs: %d", ret);
		return ret;
	}

	ret = init_network_events();
	if (ret) {
		LOG_ERR("Failed to initialize network events: %d", ret);
		return ret;
	}
	k_sem_take(&wpa_supplicant_ready_sem, K_FOREVER);
	LOG_INF("WPA Supplicant is ready!");

#if IS_ENABLED(CONFIG_WIFI_LATENCY_TEST_DEVICE_ROLE_TX)
	/* TX device */
	LOG_INF("Device role: TX");

#if IS_ENABLED(CONFIG_WIFI_LATENCY_TEST_PACKET_TYPE_RAW)
	/* Raw packet transmission */
	ret = raw_tx_init();
	if (ret) {
		LOG_ERR("Failed to initialize raw TX: %d", ret);
		return ret;
	}

	/* Wait for interface to become operational */
	ret = k_sem_take(&iface_up_sem, K_SECONDS(30));
	if (ret) {
		LOG_ERR("Timeout waiting for interface to become operational");
		return ret;
	}

	/* Initialize buttons for TX control */
	ret = dk_buttons_init(button_handler);
	if (ret) {
		LOG_ERR("Failed to initialize buttons: %d", ret);
		return ret;
	}

	LOG_INF("Raw packet TX initialized, starting TX task");
	LOG_INF("Button 1: Start/restart raw packet transmission");
	raw_tx_task();

#elif IS_ENABLED(CONFIG_WIFI_LATENCY_TEST_PACKET_TYPE_UDP)
	/* UDP packet transmission */
	ret = conn_mgr_all_if_connect(true);
	if (ret) {
		LOG_ERR("Failed to initiate network connection: %d", ret);
		return ret;
	}
	LOG_INF("Network connection initiated, waiting for IPv4 DHCP bond...");
	k_sem_take(&ipv4_dhcp_bond_sem, K_FOREVER);

	/* Initialize buttons for TX control */
	ret = dk_buttons_init(button_handler);
	if (ret) {
		LOG_ERR("Failed to initialize buttons: %d", ret);
		return ret;
	}

	LOG_INF("Network connected successfully, starting TX task");
	LOG_INF("Button 1: Start/restart packet transmission");
	udp_tx_task();
#endif

#elif IS_ENABLED(CONFIG_WIFI_LATENCY_TEST_DEVICE_ROLE_RX)

#if IS_ENABLED(CONFIG_WIFI_LATENCY_TEST_PACKET_TYPE_RAW)
	/* Raw packet reception */

#if IS_ENABLED(CONFIG_RAW_RX_DEV_MODE_MONITOR)
	/* Monitor mode */
	LOG_INF("Device role: RX (Monitor mode)");
	ret = raw_rx_dev_monitor_init();
	if (ret) {
		LOG_ERR("Failed to initialize monitor mode: %d", ret);
		return ret;
	}
	/* Wait for interface to become operational */
	ret = k_sem_take(&iface_up_sem, K_SECONDS(30));
	if (ret) {
		LOG_ERR("Timeout waiting for interface to become operational");
		return ret;
	}
	raw_rx_dev_monitor_task();

#elif IS_ENABLED(CONFIG_RAW_RX_DEV_MODE_PROMISCUOUS)
	/* Promiscuous mode */
	LOG_INF("Device role: RX (Promiscuous mode)");

	/* Need to connect to AP first for promiscuous mode */
	ret = connect_with_retry(60);
	if (ret) {
		LOG_ERR("Failed to establish network connection for promiscuous mode");
		return ret;
	}

	ret = raw_rx_dev_promiscuous_init();
	if (ret) {
		LOG_ERR("Failed to initialize promiscuous mode: %d", ret);
		return ret;
	}
	raw_rx_dev_promiscuous_task();
#endif

#elif IS_ENABLED(CONFIG_WIFI_LATENCY_TEST_PACKET_TYPE_UDP)
	/* UDP packet reception */

#if IS_ENABLED(CONFIG_UDP_RX_DEV_MODE_SOFTAP)
	/* RX device in SoftAP mode */
	LOG_INF("Device role: RX (SoftAP mode)");

	ret = wifi_run_softap_mode();
	if (ret) {
		LOG_ERR("Failed to setup SoftAP mode: %d", ret);
		return ret;
	}
	ret = k_sem_take(&ipv4_dhcp_bond_sem, K_FOREVER);
	/* Print detailed WiFi status when connected */
	wifi_print_status();

	LOG_INF("SoftAP setup complete, waiting for station to connect...");
	LOG_INF("SSID: %s", CONFIG_SOFTAP_SSID);
	LOG_INF("Password: %s", CONFIG_SOFTAP_PASSWORD);
	LOG_INF("UDP server will start once a station connects");

	/* Wait for a station to connect before starting UDP RX */
	ret = k_sem_take(&station_connected_sem, K_FOREVER);
	if (ret) {
		LOG_ERR("Error waiting for station connection: %d", ret);
		return ret;
	}

	LOG_INF("Station connected! Starting RX server...");

#elif IS_ENABLED(CONFIG_UDP_RX_DEV_MODE_STA)
	/* RX device in station mode */
	LOG_INF("Device role: RX (Station mode)");
	ret = conn_mgr_all_if_connect(true);
	if (ret) {
		LOG_ERR("Failed to initiate network connection: %d", ret);
		return ret;
	}
	LOG_INF("Network connection initiated, waiting for IPv4 DHCP bond...");
	k_sem_take(&ipv4_dhcp_bond_sem, K_FOREVER);

	LOG_INF("Network connected successfully, starting RX task");
#endif /* CONFIG_UDP_RX_DEV_MODE_SOFTAP */

	udp_rx_task();
#endif

#else
	LOG_ERR("No valid device role configured");
	return -1;
#endif

	/* Should not reach here */
	return 0;
}
```

## src/led_utils.c
```c
/*
 * Copyright (c) 2025 Nordic Semiconductor ASA
 *
 * SPDX-License-Identifier: LicenseRef-Nordic-5-Clause
 */

#include <zephyr/kernel.h>
#include <zephyr/logging/log.h>
#include <dk_buttons_and_leds.h>

#include "led_utils.h"

LOG_MODULE_REGISTER(led_utils, CONFIG_LOG_DEFAULT_LEVEL);

/* LED definitions - Only 2 LEDs available on board */
#define TX_TRIGGER_LED DK_LED1
#define RX_TRIGGER_LED DK_LED2

/* LED trigger duration in milliseconds */
#define LED_TRIGGER_DURATION_MS 50

/* Work items for LED triggers */
static struct k_work_delayable tx_led_work;
static struct k_work_delayable rx_led_work;

static void tx_led_work_handler(struct k_work *work)
{
	/* Turn off TX LED */
	dk_set_led_off(TX_TRIGGER_LED);
}

static void rx_led_work_handler(struct k_work *work)
{
	/* Turn off RX LED */
	dk_set_led_off(RX_TRIGGER_LED);
}

int led_init(void)
{
	int ret;

	LOG_INF("Initializing LEDs");

	/* Initialize DK LEDs */
	ret = dk_leds_init();
	if (ret) {
		LOG_ERR("Failed to initialize DK LEDs: %d", ret);
		return ret;
	}

	/* Initialize work items for LED triggers */
	k_work_init_delayable(&tx_led_work, tx_led_work_handler);
	k_work_init_delayable(&rx_led_work, rx_led_work_handler);

	/* Turn off all LEDs initially */
	dk_set_leds(DK_NO_LEDS_MSK);

	LOG_INF("LEDs initialized successfully");
	LOG_INF("LED1: TX trigger (flashes when transmitting packets)");
	LOG_INF("LED2: RX trigger (flashes when receiving packets)");

	return 0;
}

void led_set_network_status(bool connected)
{
	/* Network status indication removed - only 2 LEDs available */
	if (connected) {
		LOG_INF("Network connected");
	} else {
		LOG_INF("Network disconnected");
	}
}

void led_trigger_tx(void)
{
	/* Turn on TX LED */
	dk_set_led_on(TX_TRIGGER_LED);

	/* Cancel any pending work and schedule new work to turn off the LED */
	k_work_cancel_delayable(&tx_led_work);
	k_work_schedule(&tx_led_work, K_MSEC(LED_TRIGGER_DURATION_MS));
}

void led_trigger_rx(void)
{
	/* Turn on RX LED */
	dk_set_led_on(RX_TRIGGER_LED);

	/* Cancel any pending work and schedule new work to turn off the LED */
	k_work_cancel_delayable(&rx_led_work);
	k_work_schedule(&rx_led_work, K_MSEC(LED_TRIGGER_DURATION_MS));
}
```

## src/led_utils.h
```c
/*
 * Copyright (c) 2025 Nordic Semiconductor ASA
 *
 * SPDX-License-Identifier: LicenseRef-Nordic-5-Clause
 */

#ifndef LED_UTILS_H
#define LED_UTILS_H

#include <zephyr/kernel.h>

/**
 * @brief Initialize LED functionality
 *
 * @return 0 on success, negative error code on failure
 */
int led_init(void);

/**
 * @brief Set network status (logging only - no LED indication)
 *
 * @param connected true if network is connected, false otherwise
 */
void led_set_network_status(bool connected);

/**
 * @brief Trigger LED1 to indicate packet transmission
 */
void led_trigger_tx(void);

/**
 * @brief Trigger LED2 to indicate packet reception
 */
void led_trigger_rx(void);

#endif /* LED_UTILS_H */
```

## src/net_event_mgmt.c
```c
/*
 * Copyright (c) 2025 Nordic Semiconductor ASA
 *
 * SPDX-License-Identifier: LicenseRef-Nordic-5-Clause
 */

#include <zephyr/logging/log.h>
#include <zephyr/net/net_if.h>
#include <supp_events.h>
#include <zephyr/net/socket.h>

#include "net_event_mgmt.h"
#include "wifi_utils.h"

LOG_MODULE_REGISTER(net_event_mgmt, CONFIG_LOG_DEFAULT_LEVEL);

/* Event masks for different network layers */
#define L2_IF_EVENT_MASK        (NET_EVENT_IF_DOWN | NET_EVENT_IF_UP)
#define L2_WIFI_CONN_EVENT_MASK (NET_EVENT_WIFI_CONNECT_RESULT | NET_EVENT_WIFI_DISCONNECT_RESULT)
#define L2_WIFI_SOFTAP_EVENT_MASK                                                                  \
	(NET_EVENT_WIFI_AP_ENABLE_RESULT | NET_EVENT_WIFI_AP_STA_CONNECTED |                       \
	 NET_EVENT_WIFI_AP_STA_DISCONNECTED)
#define L3_WPA_SUPP_EVENT_MASK (NET_EVENT_SUPPLICANT_READY | NET_EVENT_SUPPLICANT_NOT_READY)
#define L3_IPV4_EVENT_MASK     NET_EVENT_IPV4_DHCP_BOUND

/* Define network event semaphores */
K_SEM_DEFINE(iface_up_sem, 0, 1);
K_SEM_DEFINE(wpa_supplicant_ready_sem, 0, 1);
K_SEM_DEFINE(ipv4_dhcp_bond_sem, 0, 1);
/* Function declarations */

/* Declare the callback structures for Wi-Fi and network events */
static struct net_mgmt_event_callback iface_event_cb;
static struct net_mgmt_event_callback wpa_event_cb;
static struct net_mgmt_event_callback wifi_event_cb;
static struct net_mgmt_event_callback ipv4_event_cb;
#if IS_ENABLED(CONFIG_UDP_RX_DEV_MODE_SOFTAP)
static struct net_mgmt_event_callback softap_event_cb;

/* SoftAP support */
bool dhcp_server_started = false;
static K_MUTEX_DEFINE(softap_mutex);
K_SEM_DEFINE(station_connected_sem, 0, 1); /* Semaphore to wait for station connection */

struct softap_station {
	bool valid;
	struct wifi_ap_sta_info info;
	struct in_addr ip_addr; /* Store station's IP address */
};

#define MAX_SOFTAP_STATIONS 4
static struct softap_station connected_stations[MAX_SOFTAP_STATIONS];
#endif /* CONFIG_UDP_RX_DEV_MODE_SOFTAP */

static void l2_iface_event_handler(struct net_mgmt_event_callback *cb, uint32_t mgmt_event,
				   struct net_if *iface)
{
	char ifname[IFNAMSIZ + 1] = {0};
	int ret;
	switch (mgmt_event) {
	case NET_EVENT_IF_UP:
		ret = net_if_get_name(iface, ifname, sizeof(ifname) - 1);
		if (ret < 0) {
			LOG_ERR("Cannot get interface %d (%p) name", net_if_get_by_iface(iface),
				iface);
		}
		LOG_INF("Network interface %s is up", ifname);
		k_sem_give(&iface_up_sem);
		break;
	case NET_EVENT_IF_DOWN:
		ret = net_if_get_name(iface, ifname, sizeof(ifname) - 1);
		if (ret < 0) {
			LOG_ERR("Cannot get interface %d (%p) name", net_if_get_by_iface(iface),
				iface);
		}
		LOG_INF("Network interface %s is down", ifname);
		break;
	default:
		LOG_DBG("Unhandled network event: 0x%08X", mgmt_event);
		break;
	}
}

#if IS_ENABLED(CONFIG_UDP_RX_DEV_MODE_SOFTAP)

static int get_station_ip_address(const uint8_t *mac, struct in_addr *ip_addr)
{
	struct net_if *iface;
	int station_count = 0;

	iface = net_if_get_first_wifi();
	if (!iface) {
		return -1;
	}

	/* Count existing stations to assign next sequential IP */
	k_mutex_lock(&softap_mutex, K_FOREVER);
	for (int i = 0; i < MAX_SOFTAP_STATIONS; i++) {
		if (connected_stations[i].valid && connected_stations[i].ip_addr.s_addr != 0) {
			station_count++;
		}
	}
	k_mutex_unlock(&softap_mutex);

	/* Assign IP based on DHCP pool logic: 192.168.1.2, 192.168.1.3, etc. */
	/* DHCP server starts from 192.168.1.2, so assign sequentially */
	uint32_t base_ip = 0xC0A80102; /* 192.168.1.2 in network byte order (host order) */
	uint32_t assigned_ip = base_ip + station_count;

	ip_addr->s_addr = htonl(assigned_ip);

	LOG_DBG("Assigned IP for station: 192.168.1.%d (station count: %d)", 2 + station_count,
		station_count + 1);

	return 0;
}

static void handle_softap_enable_result(struct net_mgmt_event_callback *cb)
{
	const struct wifi_status *status = (const struct wifi_status *)cb->info;

	if (status->status) {
		LOG_ERR("SoftAP enable failed: %d", status->status);
	} else {
		LOG_INF("SoftAP enabled successfully");
		/* Signal network connectivity for SoftAP mode */
		k_sem_give(&ipv4_dhcp_bond_sem);
	}
}

static void handle_station_connected(struct net_mgmt_event_callback *cb)
{
	const struct wifi_ap_sta_info *sta_info = (const struct wifi_ap_sta_info *)cb->info;
	int station_slot = -1;

	k_mutex_lock(&softap_mutex, K_FOREVER);

	/* Find empty slot for new station */
	for (int i = 0; i < MAX_SOFTAP_STATIONS; i++) {
		if (!connected_stations[i].valid) {
			connected_stations[i].valid = true;
			connected_stations[i].info = *sta_info;
			connected_stations[i].ip_addr.s_addr = 0; /* Initialize as unassigned */
			station_slot = i;
			break;
		}
	}

	k_mutex_unlock(&softap_mutex);

	uint8_t mac_str[18];
	snprintf(mac_str, sizeof(mac_str), "%02x:%02x:%02x:%02x:%02x:%02x", sta_info->mac[0],
		 sta_info->mac[1], sta_info->mac[2], sta_info->mac[3], sta_info->mac[4],
		 sta_info->mac[5]);

	/* Try to get IP address after a short delay for DHCP assignment */
	k_sleep(K_MSEC(1000)); /* Wait 1 second for DHCP to assign IP */

	if (station_slot >= 0) {
		struct in_addr ip_addr;
		if (get_station_ip_address(sta_info->mac, &ip_addr) == 0) {
			k_mutex_lock(&softap_mutex, K_FOREVER);
			connected_stations[station_slot].ip_addr = ip_addr;
			k_mutex_unlock(&softap_mutex);

			char ip_str[INET_ADDRSTRLEN];
			inet_ntop(AF_INET, &ip_addr, ip_str, sizeof(ip_str));
			LOG_INF("Station %s assigned IP: %s", mac_str, ip_str);
		} else {
			LOG_WRN("Could not determine IP address for station %s", mac_str);
		}
	}

	/* Signal that a station has connected - this will allow UDP RX task to start */
	k_sem_give(&station_connected_sem);
	LOG_INF("First station connected - UDP RX task can now start");
}

static void handle_station_disconnected(struct net_mgmt_event_callback *cb)
{
	const struct wifi_ap_sta_info *sta_info = (const struct wifi_ap_sta_info *)cb->info;
	char mac_str[18];
	char ip_str[INET_ADDRSTRLEN] = "Unknown";

	snprintf(mac_str, sizeof(mac_str), "%02x:%02x:%02x:%02x:%02x:%02x", sta_info->mac[0],
		 sta_info->mac[1], sta_info->mac[2], sta_info->mac[3], sta_info->mac[4],
		 sta_info->mac[5]);

	k_mutex_lock(&softap_mutex, K_FOREVER);

	/* Find and remove station from list, also get its IP address */
	for (int i = 0; i < MAX_SOFTAP_STATIONS; i++) {
		if (connected_stations[i].valid &&
		    memcmp(connected_stations[i].info.mac, sta_info->mac, 6) == 0) {

			/* Get IP address before removing */
			if (connected_stations[i].ip_addr.s_addr != 0) {
				inet_ntop(AF_INET, &connected_stations[i].ip_addr, ip_str,
					  sizeof(ip_str));
			}

			connected_stations[i].valid = false;
			connected_stations[i].ip_addr.s_addr = 0;
			break;
		}
	}

	k_mutex_unlock(&softap_mutex);

	LOG_INF("Station disconnected: MAC=%s, IP=%s", mac_str, ip_str);

	/* Check if any stations are still connected */
	k_mutex_lock(&softap_mutex, K_FOREVER);
	bool any_connected = false;
	for (int i = 0; i < MAX_SOFTAP_STATIONS; i++) {
		if (connected_stations[i].valid) {
			any_connected = true;
			break;
		}
	}
	k_mutex_unlock(&softap_mutex);

	if (!any_connected) {
		LOG_INF("No stations remaining connected to SoftAP");
		/* Note: UDP server continues running even if no stations connected */
		/* This allows for immediate packet reception when a new station connects */
	}
}

static void l2_wifi_softap_event_handler(struct net_mgmt_event_callback *cb, uint32_t mgmt_event,
					 struct net_if *iface)
{
	switch (mgmt_event) {
	case NET_EVENT_WIFI_AP_ENABLE_RESULT:
		handle_softap_enable_result(cb);
		break;
	case NET_EVENT_WIFI_AP_STA_CONNECTED:
		handle_station_connected(cb);
		break;
	case NET_EVENT_WIFI_AP_STA_DISCONNECTED:
		handle_station_disconnected(cb);
		break;
	default:
		break;
	}
}
#endif /* CONFIG_UDP_RX_DEV_MODE_SOFTAP */

/* Enhanced WiFi management event handler for L2 events */
static void l2_wifi_conn_event_handler(struct net_mgmt_event_callback *cb, uint32_t mgmt_event,
				       struct net_if *iface)
{
	switch (mgmt_event) {
	case NET_EVENT_WIFI_CONNECT_RESULT: {
		const struct wifi_status *status = (const struct wifi_status *)cb->info;

		if (status->status == 0) {
			/* Connection successful */
			LOG_INF("WiFi L2 connection successful");
			/* Print detailed WiFi status when connected */
			wifi_print_status();
		} else {
			/* Decode common error codes */
			switch (status->status) {
			case 1:
				LOG_ERR("  Reason: Generic failure");
				break;
			case 2:
				LOG_ERR("  Reason: Authentication timeout");
				break;
			case 3:
				LOG_ERR("  Reason: Authentication failed");
				break;
			case 15:
				LOG_ERR("  Reason: AP not found");
				break;
			case 16:
				LOG_ERR("  Reason: Association timeout");
				break;
			default:
				LOG_ERR("  Reason: Unknown error code %d", status->status);
				break;
			}
		}
	} break;

	case NET_EVENT_WIFI_DISCONNECT_RESULT: {
		const struct wifi_status *status = (const struct wifi_status *)cb->info;
		LOG_INF("WiFi disconnected: status=%d", status ? status->status : -1);
	} break;

	default:
		LOG_DBG("Unhandled WiFi event: 0x%08X", mgmt_event);
		break;
	}
}

/* wpa supplicant events */
static void l3_wpa_supp_event_handler(struct net_mgmt_event_callback *cb, uint32_t mgmt_event,
				      struct net_if *iface)
{
	switch (mgmt_event) {
	case NET_EVENT_SUPPLICANT_READY:
		LOG_INF("WPA Supplicant is ready");
		k_sem_give(&wpa_supplicant_ready_sem);
		break;
	case NET_EVENT_SUPPLICANT_NOT_READY:
		LOG_ERR("WPA Supplicant is not ready");
		break;
	default:
		LOG_DBG("Unhandled WPA Supplicant event: 0x%08X", mgmt_event);
		break;
	}
}

/* Enhanced network management event handler for L3 events */
static void l3_ipv4_event_handler(struct net_mgmt_event_callback *cb, uint32_t mgmt_event,
				  struct net_if *iface)
{
	if ((mgmt_event & L3_IPV4_EVENT_MASK) != mgmt_event) {
		return;
	}

	switch (mgmt_event) {
	case NET_EVENT_IPV4_DHCP_BOUND:
		LOG_INF("Network DHCP bound - L3 connectivity established");
		/* Print IP address information */
		wifi_print_dhcp_ip(cb);
		/* Signal network connectivity */
		k_sem_give(&ipv4_dhcp_bond_sem);
		break;
	default:
		LOG_DBG("Unhandled network event: 0x%08X", mgmt_event);
		break;
	}
}

int init_network_events(void)
{
	LOG_INF("Initializing network event handlers");

	/* Initialize network event callbacks */
	net_mgmt_init_event_callback(&iface_event_cb, l2_iface_event_handler, L2_IF_EVENT_MASK);
	net_mgmt_add_event_callback(&iface_event_cb);
	LOG_DBG("Network interface event handler registered");

	/* Initialize and add the callback function for WPA Supplicant events */
	net_mgmt_init_event_callback(&wpa_event_cb, l3_wpa_supp_event_handler,
				     L3_WPA_SUPP_EVENT_MASK);
	net_mgmt_add_event_callback(&wpa_event_cb);
	LOG_DBG("WPA Supplicant event handler registered");

	/* Initialize and add the callback function for WiFi events (L2) */
	net_mgmt_init_event_callback(&wifi_event_cb, l2_wifi_conn_event_handler,
				     L2_WIFI_CONN_EVENT_MASK);
	net_mgmt_add_event_callback(&wifi_event_cb);
	LOG_DBG("WiFi L2 event handler registered");

#if IS_ENABLED(CONFIG_UDP_RX_DEV_MODE_SOFTAP)
	/* Initialize SoftAP event callbacks */
	net_mgmt_init_event_callback(&softap_event_cb, l2_wifi_softap_event_handler,
				     L2_WIFI_SOFTAP_EVENT_MASK);
	net_mgmt_add_event_callback(&softap_event_cb);
	LOG_DBG("SoftAP event handler registered");
#endif /* CONFIG_UDP_RX_DEV_MODE_SOFTAP */

	/* Initialize and add the callback function for network events (L3) */
	net_mgmt_init_event_callback(&ipv4_event_cb, l3_ipv4_event_handler, L3_IPV4_EVENT_MASK);
	net_mgmt_add_event_callback(&ipv4_event_cb);
	LOG_DBG("Network L3 event handler registered");

	LOG_INF("All network event handlers initialized successfully");
	return 0;
}
```

## src/net_event_mgmt.h
```c
/*
 * Copyright (c) 2025 Nordic Semiconductor ASA
 *
 * SPDX-License-Identifier: LicenseRef-Nordic-5-Clause
 */

#ifndef NET_MGMT_H
#define NET_MGMT_H

#include <zephyr/kernel.h>
#include <zephyr/net/net_mgmt.h>
#include <zephyr/net/net_event.h>
#include <zephyr/net/wifi_mgmt.h>

/**
 * @brief Initialize network event handlers
 *
 * Sets up all network management event callbacks for different layers
 *
 * @return 0 on success, negative error code on failure
 */
int init_network_events(void);

#endif /* NET_MGMT_H */
```

## src/net_event_mgmt_utils.h
```c
/*
 * Copyright (c) 2025 Nordic Semiconductor ASA
 *
 * SPDX-License-Identifier: LicenseRef-Nordic-5-Clause
 */

#ifndef NET_EVENT_MGMT_UTILS_H
#define NET_EVENT_MGMT_UTILS_H

#include <zephyr/kernel.h>
#include <zephyr/net/net_mgmt.h>
#include <zephyr/net/net_event.h>
#include <zephyr/net/wifi_mgmt.h>

/**
 * @brief Initialize network event handlers
 *
 * Sets up all network management event callbacks for different layers
 *
 * @return 0 on success, negative error code on failure
 */
int init_network_events(void);

/* External semaphores for network events */
extern struct k_sem iface_up_sem;
extern struct k_sem wpa_supplicant_ready_sem;
extern struct k_sem ipv4_dhcp_bond_sem;

#if IS_ENABLED(CONFIG_WIFI_NM_WPA_SUPPLICANT_AP)
extern struct k_sem station_connected_sem;
#endif

#endif /* NET_EVENT_MGMT_UTILS_H */
```
